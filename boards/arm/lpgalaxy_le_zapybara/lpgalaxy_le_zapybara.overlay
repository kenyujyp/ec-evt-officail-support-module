/*
 * Copyright (c) 2020 The ZMK Contributors
 *
 * SPDX-License-Identifier: MIT
 */

#include <zephyr/dt-bindings/dt-util.h>
#include <zephyr/dt-bindings/gpio/nordic-nrf-gpio.h>

#include <freq.h>

&matrix {
		precalib-avg-highs = <
		3509
		3278
		3054
		3106
	>;
        precalib-avg-lows = <
		63
		63
		62
		81
	>;
};